## configs/stm32f401-navigation/Kconfig
```kconfig
#
# For a description of the syntax of this configuration file,
# see the file kconfig-language.txt in the NuttX tools repository.
#

if ARCH_BOARD_STM32F401_NAVIGATION

config NAV_BOARD_AT24_BLOCKMOUNT
	bool "AT24 Serial EEPROM auto-mount"
	default n
	depends on NSH_ARCHINIT && STM32_I2C1 && MTD_AT24XX
	---help---
		Automatically initialize the AT24 I2C EEPROM driver when NSH starts.

choice
	prompt "AT24 serial EPPROM configuration"
	default NAV_BOARD_AT24_FTL
	depends on NAV_BOARD_AT24_BLOCKMOUNT

config NAV_BOARD_AT24_FTL
	bool "Create AT24 block driver"
	---help---
		Create the MTD driver for the AT24 and "wrap" the AT24 as a standard
		block driver that could then, for example, be mounted using FAT or
		any other file system.  Any file system may be used, but there will
		be no wear-leveling.

config NAV_BOARD_AT24_NXFFS
	bool "Create AT24 NXFFS file system"
	depends on FS_NXFFS
	---help---
		Create the MTD driver for the AT24 and mount the AT24 device as
		a wear-leveling, NuttX FLASH file system (NXFFS).  The downside of
		NXFFS is that it can be very slow.

endchoice # AT24 serial EPPROM configuration

config STM32F401NAVIGATION_FLASH
	bool "MTD driver for external 8Mbyte W25Q64JVSSIQ FLASH on SPI1"
	default n
	select MTD
	select MTD_W25
	select MTD_SMART
	select FS_SMARTFS
	select STM32_SPI1
	select MTD_BYTE_WRITE
	---help---
		Configures an MTD device for use with the onboard flash

config STM32F401NAVIGATION_FLASH_MINOR
	int "Minor number for the FLASH /dev/smart entry"
	default 0
	depends on STM32F401NAVIGATION_FLASH
	---help---
		Sets the minor number for the FLASH MTD /dev entry

config STM32F401NAVIGATION_FLASH_PART
	bool "Enable partition support on FLASH"
	default y
	depends on STM32F401NAVIGATION_FLASH
	select MTD_PARTITION
	---help---
		Enables creation of partitions on the FLASH

config STM32F401NAVIGATION_FLASH_CONFIG_PART
	bool "Create application config data partition on FLASH"
	default n
	depends on STM32F401NAVIGATION_FLASH_PART
	depends on PLATFORM_CONFIGDATA
	---help---
		Enables creation of a /dev/config partition on the FLASH

config STM32F401NAVIGATION_FLASH_CONFIG_PART_NUMBER
	int "Index number of config partition (in list below)"
	default 0
	depends on STM32F401NAVIGATION_FLASH_CONFIG_PART
	---help---
		Specifies the index number of the config data partition
		from the partition list.

config STM32F401NAVIGATION_FLASH_PART_LIST
	string "Flash partition size list"
	default "2048,2048,2048,2048"
	depends on STM32F401NAVIGATION_FLASH_PART
	---help---
		Comma separated list of partition sizes in KB.

config STM32F401NAVIGATION_FLASH_PART_NAMES
	string "Flash partition name list"
	default "first,second,third,forth"
	depends on STM32F401NAVIGATION_FLASH_PART
	depends on MTD_PARTITION_NAMES
	---help---
		Comma separated list of partition names.

config STM32_ROMFS
	bool "Automount baked-in ROMFS image"
	default n
	depends on FS_ROMFS
	---help---
		Select STM32_ROMFS_IMAGEFILE, STM32_ROMFS_DEV_MINOR, STM32_ROMFS_MOUNTPOINT

config STM32_ROMFS_DEV_MINOR
	int "Minor for the block device backing the data"
	depends on STM32_ROMFS
	default 64

config STM32_ROMFS_MOUNTPOINT
	string "Mountpoint of the custom romfs image"
	depends on STM32_ROMFS
	default "/rom"

config STM32_ROMFS_IMAGEFILE
	string "ROMFS image file to include into build"
	depends on STM32_ROMFS
	default "../../../rom.img"

endif  # ARCH_BOARD_NAV_BOARD
```
